## CMakeLists.txt
```
cmake_minimum_required(VERSION 3.20.0)
find_package(Zephyr REQUIRED HINTS $ENV{ZEPHYR_BASE})
project(hello_world)

target_sources(app PRIVATE src/main.c)

# Add GPIO tracing hooks when tracing is enabled
if(CONFIG_TRACING_GPIO AND CONFIG_TRACING_USER)
    target_sources(app PRIVATE src/trace_hooks.c)
endif()
```

## prj.conf
```kconfig
CONFIG_GPIO=y
CONFIG_SERIAL=y
CONFIG_UART_INTERRUPT_DRIVEN=y
```

## boards/native_sim.conf
```kconfig
CONFIG_TRACING=y
CONFIG_TRACING_GPIO=y
CONFIG_TRACING_USER=y
CONFIG_DEBUG_OPTIMIZATIONS=y
```

## src/main.c
```c
#include <zephyr/kernel.h>
#include <zephyr/drivers/gpio.h>
#include <zephyr/drivers/uart.h>

#define LED0_NODE DT_ALIAS(led0)
static const struct gpio_dt_spec led = GPIO_DT_SPEC_GET(LED0_NODE, gpios);

static const struct device *uart = DEVICE_DT_GET(DT_CHOSEN(zephyr_console));

static void uart_cb(const struct device *dev, void *user_data) {
    uint8_t c;
    if (uart_irq_rx_ready(dev) && uart_fifo_read(dev, &c, 1) == 1) {
        printk("You pressed: %c\n", c);
    }
}

int main(void) {
    if (!gpio_is_ready_dt(&led)) {
        return -1;
    }
    gpio_pin_configure_dt(&led, GPIO_OUTPUT_ACTIVE);

    if (!device_is_ready(uart)) {
        return -1;
    }
    uart_irq_callback_set(uart, uart_cb);
    uart_irq_rx_enable(uart);

    int led_state = 0;
    while (1) {
        led_state = !led_state;
        gpio_pin_set_dt(&led, led_state);
        k_msleep(500);
    }
    return 0;
}
```

## src/trace_hooks.c
```c
/*
 * GPIO Tracing Hooks for native_sim
 * 
 * This file provides debug output for GPIO operations when running on native_sim.
 * It uses Zephyr's tracing subsystem to hook into GPIO calls without modifying main.c.
 * 
 * How it works:
 * - Zephyr's tracing system defines weak `_user` callback functions
 * - When CONFIG_TRACING_GPIO=y and CONFIG_TRACING_USER=y are set, these callbacks
 *   are invoked on GPIO operations
 * - We override the weak functions to print debug messages
 * - gpio_emul_output_get() reads the actual GPIO state from the emulator
 * 
 * Enabled via boards/native_sim.conf:
 *   CONFIG_TRACING=y
 *   CONFIG_TRACING_GPIO=y
 *   CONFIG_TRACING_USER=y
 * 
 * This file is conditionally compiled only when tracing is enabled (see CMakeLists.txt)
 */

#include <zephyr/kernel.h>
#include <zephyr/drivers/gpio.h>
#include <zephyr/drivers/gpio/gpio_emul.h>

void sys_trace_gpio_port_set_bits_raw_exit_user(const struct device *port, int ret)
{
    /* Called when setting GPIO high */
    int state = gpio_emul_output_get(port, 0);
    printk("[DEBUG] (GPIO) LED state: %s\n", state ? "ON" : "OFF");
}

void sys_trace_gpio_port_clear_bits_raw_exit_user(const struct device *port, int ret)
{
    /* Called when setting GPIO low */
    int state = gpio_emul_output_get(port, 0);
    printk("[DEBUG] (GPIO) LED state: %s\n", state ? "ON" : "OFF");
}

void sys_trace_gpio_pin_configure_exit_user(const struct device *port,
                                            gpio_pin_t pin, int ret)
{
    printk("[DEBUG] (GPIO) pin %d configured (ret=%d)\n", pin, ret);
}
```
